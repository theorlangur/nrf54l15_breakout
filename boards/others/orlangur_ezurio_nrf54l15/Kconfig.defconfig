## boards/others/orlangur_ezurio_nrf54l15/Kconfig.defconfig
```kconfig
# Copyright (c) 2024 Nordic Semiconductor ASA
# SPDX-License-Identifier: Apache-2.0

# Workaround for not being able to have commas in macro arguments
DT_CHOSEN_Z_CODE_PARTITION := zephyr,code-partition
DT_CHOSEN_Z_SRAM_PARTITION := zephyr,sram-secure-partition

if BOARD_ORLANGUR_EZURIO_NRF54L15_CPUAPP

config ROM_START_OFFSET
	default 0 if PARTITION_MANAGER_ENABLED
	default 0x800 if BOOTLOADER_MCUBOOT

endif # BOARD_ORLANGUR_EZURIO_NRF54L15_CPUAPP
```

## boards/others/orlangur_ezurio_nrf54l15/Kconfig.orlangur_ezurio_nrf54l15
```kconfig
# Copyright (c) 2024 Nordic Semiconductor ASA
# SPDX-License-Identifier: Apache-2.0

config BOARD_ORLANGUR_EZURIO_NRF54L15
	select SOC_NRF54L15_CPUAPP if BOARD_ORLANGUR_EZURIO_NRF54L15_NRF54L15_CPUAPP || BOARD_ORLANGUR_EZURIO_NRF54L15_NRF54L15_CPUAPP_DEF
```

## boards/others/orlangur_ezurio_nrf54l15/board.yml
```yaml
board:
  name: orlangur_ezurio_nrf54l15
  full_name: Orlangur Ezurio nRF54L15 Breakout
  vendor: orlangur
  socs:
  - name: nrf54l15
    variants:
    - name: def
      cpucluster: cpuapp
```

## boards/others/orlangur_ezurio_nrf54l15/orlangur_ezurio_nrf54l15_cpuapp_defconfig
```kconfig
CONFIG_CLOCK_CONTROL_NRF_K32SRC_XTAL=y
CONFIG_CLOCK_CONTROL_NRF_K32SRC_20PPM=y

# Start SYSCOUNTER on driver init
CONFIG_NRF_GRTC_START_SYSCOUNTER=y
```
